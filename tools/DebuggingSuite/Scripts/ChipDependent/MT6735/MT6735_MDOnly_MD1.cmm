;; MT6735_MDOnly_MD.cmm
ENTRY &MD_OPT_RESET

;;;;;;;;;;;;;;;;;;;;;;;;;;;;;;;;;;;;;;;;;;;;;;;;;;;;;;;;;;;;;;;;;;;;;;
;;;;;     START Cortex-R4 VIEW                                   ;;;;;
;;;;;;;;;;;;;;;;;;;;;;;;;;;;;;;;;;;;;;;;;;;;;;;;;;;;;;;;;;;;;;;;;;;;;;
DO CR4_connect.cmm &MD_OPT_RESET
Do BuildInfo.cmm

; C15:0019 - BTCM Enable. If BTCM is enabled, which means MD1 has been loaded.
; Skip loading binary.
&MD_LOADED=DATA.LONG(C15:0x0019)
&MD_LOADED=&MD_LOADED&0x1

; If dummy AP is used, MD is loaded too.
IF &AP_SETTING==3
(
    &MD_LOADED=1
)

IF &MD_LOADED==0
(
    PRINT "Run CLK Setting"
    DO MT6735_AP_CLKCTRL.cmm MD1 MD
)

;DATA.TEST 0x0--0x1000 /random

IF &OPT_CFG_GPIO==1
(
    DO MT6735_GPIO_Additional_Init_MD1.cmm
)

; Disable AP WDT
PRINT "Disable AP MD WDT"
Data.Set SD:(0xA0212000) %LE %LONG 0x22000064

; Disable WDT
PRINT "Disable MD WDT"
PRINT "[0x&MD_RGU_BASE] <- 0x220e)"
Data.Set SD:(&MD_RGU_BASE+0x0000) %LE %WORD 0x220E

; bypass_CTIRQ1_precision_check
; Avoiding assert at CTIRQ1/2
;;; Move to MT6595_MDOnly_main.cmm
;;;PRINT "L1 Assert Bypass" 
;;;PRINT "[0x83070008] <- 0xABCD"
;;;Data.Set SD:0x83070008 %LE %WORD 0xABCD
;;;PRINT "[0x83070010] <- 0x0003"
;;;Data.Set SD:0x83070010 %LE %WORD 0x0003     ; bit0: disable CTIRQ1/2 timing check

; Remap CR4 bank F to bank 0 (Clear MD_MCU_CON0 bit31~30)
;Data.Set SD:0x80000100 %LE %LONG DATA.LONG(SD:0x80000100)&0x3FFFFFFF

IF &AP_SETTING==2
(
    PRINT "Wait 2s for TinyBootloader ..."
    WAIT 2.s
)

;; Set boot mode after TinyBL is ready
PRINT "MD Boot Mode"
PRINT "[0x80000010] <- &OPT_MD_BOOT_MODE"
; Boot Mode
Data.Set SD:(0x80000010) %LE %LONG &OPT_MD_BOOT_MODE

IF &MD_LOADED==1
(
    PRINT "MD1 is load. Skip loading binary."
    PRINT "Load MD ELF(Symbol Only)..."
    D.LOAD.ELF &OPT_MD_ELF_PATH /RELPATH /PATH &OPT_MD_SRC_PATH /nocode
    
    Break
    d.l
    
    ; skip set PC to INT_Initialize
    &AP_SETTING=3
    DO MT6735_Ramfs_config.cmm
    ENDDO
)

IF &OPT_LOAD_DSPBIN==1
(
    PRINT "Load DSP BIN(Binary Only)..."
    D.LOAD.BINARY &OPT_DSP_BIN_PATH 0x8000000 /noclear
)

IF &OPT_CFG_TCM==1
(
    LOCAL &OPT_ITCM_ADDR
    LOCAL &OPT_DTCM_ADDR
    &OPT_ITCM_ADDR="0x"+FORMAT.HEX(8, 0x0)
    &OPT_DTCM_ADDR="0x"+FORMAT.HEX(8, 0x40000)
    PRINT "Configure TCM ..."
    PRINT "ITCM &OPT_ITCM_ADDR"
    ; Set ATCM Address
    Data.Set C15:0x0119 %LE %LONG (&OPT_ITCM_ADDR|1)
    PRINT "DTCM &OPT_DTCM_ADDR"
    ; Set BTCM Address
    Data.Set C15:0x0019 %LE %LONG (&OPT_DTCM_ADDR|1)
)

IF &OPT_LOAD_ELF==1
(
    PRINT "Load MD ELF(Symbol Only)..."
    D.LOAD.ELF &OPT_MD_ELF_PATH /RELPATH /PATH &OPT_MD_SRC_PATH /nocode
)
ELSE IF &OPT_LOAD_ELF==2
(
    PRINT "Load MD ELF(Download)..."
    D.LOAD.ELF &OPT_MD_ELF_PATH /RELPATH /PATH &OPT_MD_SRC_PATH
)

IF &OPT_CFG_CACHE==1
(
    PRINT "Configure Cache ... (Enable)"
    Data.Set C15:0x0001 %LE %LONG (data.long(C15:0x0001)|(1<<2)|(1<<0xc))
)

IF &OPT_CFG_MPU==1
(
    PRINT "Configure MPU ... (Enable)"
    DO Cortex-R_MPU_Bushang_Recover.cmm
)

IF &OPT_CFG_PLL==1
(
    PRINT "Configure MD PLL ..."
    DO MT6735_MD1_PLL_Init_MD1.cmm
)

DO MT6735_Ramfs_config.cmm

ENDDO
