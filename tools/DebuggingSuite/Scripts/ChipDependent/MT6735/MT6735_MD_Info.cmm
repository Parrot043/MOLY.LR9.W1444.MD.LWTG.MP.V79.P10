;;
;; MT6735_MD_Info.cmm
;;
ENTRY &OPT_DUAL_MD
GLOBAL &OPT_MD_SEL



;; MD1 modem paths
IF OS.FILE(MT6735_MD1_Info.cmm)
(
    do MT6735_MD1_Info.cmm
)

;; For Multi-Core Debugging

GLOBAL &OPT_MD_ELF_AUTO_LOAD
&OPT_MD_ELF_AUTO_LOAD=1
;   1: auto load elf file specified in &OPT_ELF_PATH
;   0: manually select elf file
